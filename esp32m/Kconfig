## esp32m/Kconfig
```kconfig
menu "ESP32 Manager configuration"

    menu "Stack diagnostics"

        config ESP32M_STACK_REPORT
            bool "Generate project-wide compiler stack reports"
            depends on IDF_TOOLCHAIN_GCC
            default n
            help
                Optional function-frame diagnostics, disabled by default.
                Compile all source-built C/C++ components with -fstack-usage
                and generate stack-usage.txt / stack-usage.json in the build
                directory. Reports describe individual function frames and
                coverage gaps; they do not prove whole-task stack bounds.
                Precompiled libraries and separately built bootloaders are
                outside this report.

        config ESP32M_STACK_MONITOR
            bool "Warn about low remaining stack in running tasks"
            depends on !IDF_TARGET_LINUX
            select FREERTOS_USE_TRACE_FACILITY
            default y
            help
                Periodically inspect all currently live tasks from the existing
                application worker and warn through esp32m logging when their
                historical minimum free stack reaches the configured threshold.
                No extra task is created. Short-lived tasks can finish between
                samples; this monitor does not prevent or prove absence of an
                overflow. Requires bounded heap for snapshots and warning state.

        config ESP32M_STACK_MONITOR_INTERVAL_SECONDS
            int "Stack monitor sample interval (seconds)"
            depends on ESP32M_STACK_MONITOR
            range 1 86400
            default 30

        config ESP32M_STACK_MONITOR_WARN_FREE_BYTES
            int "Warn at or below minimum free stack (bytes)"
            depends on ESP32M_STACK_MONITOR
            range 64 32768
            default 512
            help
                Absolute minimum-free-stack threshold for all sampled tasks.
                Task-specific release reserves should usually be larger for
                complex or actively changing tasks. ESP-IDF reports bytes.

        config ESP32M_STACK_MONITOR_WARN_DELTA_BYTES
            int "Warn again after additional stack reserve loss (bytes)"
            depends on ESP32M_STACK_MONITOR
            range 1 8192
            default 128
            help
                After the first low-stack warning, require this further drop
                before warning again for the same task. Reaching zero always
                qualifies. Unchanged readings do not repeat warnings.

        config ESP32M_STACK_MONITOR_MAX_TASKS
            int "Maximum tasks tracked by stack monitor"
            depends on ESP32M_STACK_MONITOR
            range 16 512
            default 128
            help
                Bounds snapshot and warning-state memory. If more tasks exist,
                the monitor reports unavailable coverage rather than silently
                claiming that every task was inspected.

    endmenu
    
    menu "Logging"

        choice ESP32M_LOG_LEVEL
            bool "Default log verbosity"
            default ESP32M_LOG_LEVEL_DEFAULT
            help
                Specify how much output to see in esp32m logs.
            config ESP32M_LOG_LEVEL_NONE
                bool "No output"
            config ESP32M_LOG_LEVEL_DEFAULT
                bool "Default"
            config ESP32M_LOG_LEVEL_ERROR
                bool "Error"
            config ESP32M_LOGT_LEVEL_WARN
                bool "Warning"
            config ESP32M_LOG_LEVEL_INFO
                bool "Info"
            config ESP32M_LOG_LEVEL_DEBUG
                bool "Debug"
            config ESP32M_LOG_LEVEL_VERBOSE
                bool "Verbose"
        endchoice

        config ESP32M_LOG_LEVEL
            int
            default 0 if ESP32M_LOG_LEVEL_NONE
            default 1 if ESP32M_LOG_LEVEL_DEFAULT
            default 2 if ESP32M_LOG_LEVEL_ERROR
            default 3 if ESP32M_LOG_LEVEL_WARN
            default 4 if ESP32M_LOG_LEVEL_INFO
            default 5 if ESP32M_LOG_LEVEL_DEBUG
            default 6 if ESP32M_LOG_LEVEL_VERBOSE

        config ESP32M_LOG_CONSOLE
            bool "Send log output to UART0 serial console"
            default y

        config ESP32M_LOG_STORAGE
            bool "Enable persistent log storage and System log browser"
            default y
            help
                Provides bounded filesystem logging, browsing and export.
                Capture is initially disabled and can be enabled in System.

        config ESP32M_LOG_UDP
            bool "Send log output to remote server over UDP"
            default n
            help
                This will send UDP packets to syslogd server

        config ESP32M_LOG_UDP_HOST
            string "Host name or IP for UDP syslogd server"
            depends on ESP32M_LOG_UDP
            default "syslog.lan"
            help
                If not specified or the host name could not be resolved, 
                will attempt to send UDP packets to the default gateway

        config ESP32M_LOG_QUEUE
            bool "Queue log messages"
            help
                This option enables buffering of log messages instead of 
                sending them to appenders immediately. When the message is logged,
                it is appended to the in-memory queue and then sent to appenders
                in a separate task, to minimize delays in the calling task
                and ensure thread safety
            default y

        config ESP32M_LOG_QUEUE_SIZE
            int "Queue size, bytes"
            depends on ESP32M_LOG_QUEUE
            default 1024

        config ESP32M_LOG_HOOK_ESPIDF
            bool "Capture ESP-IDF log messages"
            help
                Redirect messages logged by ESP-IDF ESP_LOGx macros to esp32m appenders
            default y

        config ESP32M_LOG_HOOK_UART
            bool "Capture UART0 output"
            help
                Attempts to capture everything that is printed to serial console via putc() / printf().
                This may help to capture additional output that does not use ESP_LOGx macros.
                Not recommended to be used in production builds, as it has known stability issues.
            default n

        endmenu

    menu "Over the Air Updates"

        config ESP32M_NET_OTA_CHECK_FOR_UPDATES
            bool "Enable automatic checking for firmware updates"
            default n
            help
                Enables periodic checking for firmware updates using the specified HTTP URL.
                ESP32M_NET_OTA_VENDOR_URL option must be defined for this feature to work.

        config ESP32M_NET_OTA_VENDOR_URL
            string "Vendor OTA URL"
            default ""
            depends on ESP32M_NET_OTA_CHECK_FOR_UPDATES
            help 
                HTTP or HTTPS URL of the remote folder with ${appname}.json file 

        config ESP32M_NET_OTA_CHECK_INTERVAL
            depends on ESP32M_NET_OTA_CHECK_FOR_UPDATES
            int "Check interval (minutes)"
            default 360
                
        config ESP32M_NET_OTA_VENDOR_ONLY
            bool "Enable updates only from the specified vendor URL"
            default y
            depends on ESP32M_NET_OTA_CHECK_FOR_UPDATES
    
    endmenu

    choice ESP32M_FS_ROOT
        bool "File system to use by default"
        default ESP32M_FS_ROOT_SPIFFS
        help
            Specify default file system.
        config ESP32M_FS_ROOT_SPIFFS
            bool "SPIFFS"
        config ESP32M_FS_ROOT_LITTLEFS
            bool "LittleFS"
    endchoice

    config ESP32M_FS_ROOT
        int
        default 0 if ESP32M_FS_ROOT_SPIFFS
        default 1 if ESP32M_FS_ROOT_LITTLEFS

    choice ESP32M_UI_BUILD_MODE
        bool "UI build mode"
        default ESP32M_UI_BUILD_FULL
        help
            Specify default file system.
        config ESP32M_UI_BUILD_FULL
            bool "Perform full UI build every time"
        config ESP32M_UI_BUILD_ONCE
            bool "Build UI only once, don't re-build event if UI files change"
        config ESP32M_UI_BUILD_NEVER
            bool "Don't build UI, generate empty UI resources"
    endchoice

    config ESP32M_UI_BUILD_MODE
        int
        default 0 if ESP32M_UI_BUILD_FULL
        default 1 if ESP32M_UI_BUILD_ONCE
        default 2 if ESP32M_UI_BUILD_NEVER

    config ESP32M_UI_WS_HANDSHAKE_CALLBACKS
        bool
        default y
        depends on HTTPD_WS_SUPPORT
        select HTTPD_WS_PRE_HANDSHAKE_CB_SUPPORT
        select HTTPD_WS_POST_HANDSHAKE_CB_SUPPORT
        help
            Authenticate before a WebSocket upgrade and establish transport
            session identity after it. ESP-IDF 6.1 does not call the normal
            URI handler during the upgrade itself.

    config ESP32M_UI_TASK_STACK_SIZE
        int "UI worker task stack size (bytes)"
        range 4096 32768
        default 8192
        help
            Stack size for the m/ui task that dispatches WebSocket requests and
            serializes responses. Applications with larger device state or
            request handlers may need to increase this value.
        
    menu "UI HTTP server basic authentication"

        config ESP32M_UI_HTTPD_BASIC_AUTH
            bool "Enable HTTP server basic authentication"
            default n

        config ESP32M_UI_HTTPD_BASIC_AUTH_USERNAME
            string "Username"
            default "admin"
            depends on ESP32M_UI_HTTPD_BASIC_AUTH

        config ESP32M_UI_HTTPD_BASIC_AUTH_PASSWORD
            string "Password"
            default "admin"
            depends on ESP32M_UI_HTTPD_BASIC_AUTH

    endmenu

    choice ESP32M_BOARD_TYPE
        bool "Board type"
        default ESP32M_BOARD_TYPE_GENERIC
        help
            Specify board type.
        config ESP32M_BOARD_TYPE_GENERIC
            bool "Generic/custom ESP32 board"
        config ESP32M_BOARD_TYPE_XIAO_ESP32C6
            bool "SEEED STUDIO XIAO ESP32C6 board"
    endchoice

    config ESP32M_BOARD_TYPE
        int
        default 0 if ESP32M_BOARD_TYPE_GENERIC
        default 1 if ESP32M_BOARD_TYPE_XIAO_ESP32C6
        
    config ESP32M_CRASH_GUARD
        bool "Enable crash guard"
        default n


endmenu
```
